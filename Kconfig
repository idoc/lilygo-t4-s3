## Kconfig
```kconfig
menu "Board Support Package"

     choice BSP_SCREEN_ROTATION
        prompt "Screen rotation"
        default BSP_SCREEN_NO_ROTATION

        config BSP_SCREEN_NO_ROTATION
            bool "Do not rotate the display"
        config BSP_SCREEN_90_ROTATION
            bool "Rotate the display 90 degrees"
        config BSP_SCREEN_270_ROTATION
            bool "Rotate the display 270 degrees"
    endchoice

     choice BSP_COLOR_FORMAT
        prompt "Color format"
        default BSP_LV_COLOR_FORMAT_RGB565
        help
            The color format to be used by LVGL and the display

        config BSP_LV_COLOR_FORMAT_RGB565
            bool "RGB565, 16 bits per pixel"
        config BSP_LV_COLOR_FORMAT_RGB888
            bool "RGB888, 24 bits per pixel"
    endchoice

    config BSP_ERROR_CHECK
        bool "Enable error check in BSP"
        default y
        help
            Error check assert the application before returning the error code.
            
    config BSP_I2C_NUM
        int "I2C peripheral index"
        default 1
        range 0 1
        help
            ESP32S3 has two I2C peripherals, pick the one you want to use.

    menu "SPIFFS - Virtual File System"
        config BSP_SPIFFS_FORMAT_ON_MOUNT_FAIL
            bool "Format SPIFFS if mounting fails"
            default n
            help
                Format SPIFFS if it fails to mount the filesystem.

        config BSP_SPIFFS_MOUNT_POINT
            string "SPIFFS mount point"
            default "/spiffs"
            help
                Mount point of SPIFFS in the Virtual File System.

        config BSP_SPIFFS_PARTITION_LABEL
            string "Partition label of SPIFFS"
            default "storage"
            help
                Partition label which stores SPIFFS.

        config BSP_SPIFFS_MAX_FILES
            int "Max files supported for SPIFFS VFS"
            default 5
            help
                Supported max files for SPIFFS in the Virtual File System.
    endmenu

endmenu
```
